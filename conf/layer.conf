## conf/layer.conf
```bitbake
# We have a conf and classes directory, add to BBPATH
BBPATH =. "${LAYERDIR}:"

# We have a packages directory, add to BBFILES
BBFILES += " ${LAYERDIR}/recipes-*/*/*.bb "
BBFILES += " ${LAYERDIR}/recipes-*/*/*.bbappend "

BBFILE_COLLECTIONS += "wr-marvell-37xx"
BBFILE_PATTERN_wr-marvell-37xx := "^${LAYERDIR}/"
BBFILE_PRIORITY_wr-marvell-37xx = "7"

# This should only be incremented on significant changes that will
# cause compatibility issues with other layers
LAYERVERSION_wr-marvell-37xx = "1"

LAYERDEPENDS_wr-marvell-37xx = "core wrlinux"
LAYERSERIES_COMPAT_wr-marvell-37xx = "thud wrl"
```

## conf/machine/marvell-37xx.conf
```bitbake
#@TYPE: Machine
#@NAME: marvell-37xx
#@DESCRIPTION: Machine configuration for Marvell 37xx SoC

DEFAULTTUNE = "cortexa53"
require conf/machine/include/tune-cortexa53.inc

MACHINE_FEATURES = "ext3 pci usbhost vfat"

KERNEL_IMAGETYPE = "Image"
KERNEL_DEVICETREE = "marvell/armada-3720-db-B-single.dtb marvell/armada-3720-db-B-double.dtb"

SERIAL_CONSOLES ?= "115200;ttyMV0"
SERIAL_CONSOLES_CHECK ?= "${SERIAL_CONSOLES}"

IMAGE_FSTYPES += "tar.bz2"

UBOOT_CONFIG ??= "marvell-37xx"
UBOOT_CONFIG[marvell-37xx] = "mvebu_db-88f3720_defconfig"

UBOOT_MAKE_TARGET ?= "DEVICE_TREE=armada-3720-ddr4-db-v3-B"
UBOOT_BINARY = "u-boot.bin"

MACHINE_EXTRA_RRECOMMENDS = " kernel-modules"
IMAGE_FSTYPES += "tar.bz2"
IMAGE_INSTALL_append = " kernel-image-image"
IMAGE_BOOT_FILES ?= " Image"

PREFERRED_PROVIDER_virtual/bootloader_marvell-37xx ??= "u-boot-marvell"
PREFERRED_PROVIDER_virtual/kernel ??= "linux-yocto"

# multilib support
MULTILIBS ?= "multilib:lib32"
DEFAULTTUNE_virtclass-multilib-lib32 ?= "armv7athf-neon"

NON_MULTILIB_RECIPES_append = " u-boot-marvell"
```

## wic/37xx-sdimage-bootpart.wks
```
# short-description: Create SD card image as rootfs
# long-description: Creates a partitioned SD card image.

part / --source rootfs --ondisk mmcblk --fstype=ext4 --label root --align 4 --use-uuid
```
